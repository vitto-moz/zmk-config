/*
 * Copyright (c) 2020 The ZMK Contributors
 *
 * SPDX-License-Identifier: MIT
 *
 * Keyboard 1: SuperMini nRF52840 + Mifuny Corne v3 Choc v1, BLE central
 * role running on a Halcyon Dongle instead of the left half.
 */

#include "keymap_common.dtsi"
